## mosaico-usb-external/configs/espressif_esp32s31_mosaico_v1_2_uart_defconfig
```kconfig
BR2_riscv=y
BR2_riscv_custom=y
BR2_RISCV_ISA_RVM=y
BR2_RISCV_ISA_RVA=y
BR2_RISCV_ISA_RVC=y
BR2_RISCV_32=y
BR2_TOOLCHAIN_EXTERNAL=y
BR2_TOOLCHAIN_EXTERNAL_DOWNLOAD=y
BR2_TOOLCHAIN_EXTERNAL_URL="https://dl.espressif.cn/dl/toolchains/preview/riscv64/14.1.1_20260922/riscv64-esp-linux-musl-14.1.1_20260922-$(HOSTARCH)-linux-gnu.tar.xz"
BR2_TOOLCHAIN_EXTERNAL_CUSTOM_PREFIX="riscv64-esp-linux-musl"
BR2_TOOLCHAIN_EXTERNAL_HEADERS_6_6=y
BR2_TOOLCHAIN_EXTERNAL_CUSTOM_MUSL=y
BR2_TOOLCHAIN_EXTERNAL_CXX=y
BR2_DL_DIR="/userdata/esp32s31/dl"
BR2_PRIMARY_SITE="https://mirrors.nju.edu.cn/buildroot"
BR2_PRIMARY_SITE_ONLY=y
BR2_GLOBAL_PATCH_DIR="$(BR2_EXTERNAL_ESP_LINUX_BSP_PATH)/patches"
BR2_TARGET_GENERIC_HOSTNAME="esp-mosaico"
# BR2_TARGET_GENERIC_GETTY is not set
BR2_ROOTFS_OVERLAY="$(BR2_EXTERNAL_ESP_LINUX_BSP_PATH)/board/espressif/esp32s31/rootfs_overlay"
BR2_ROOTFS_POST_FAKEROOT_SCRIPT="$(BR2_EXTERNAL_ESP_LINUX_BSP_PATH)/board/espressif/esp32s31/rootfs-cramfs.sh"
BR2_ROOTFS_POST_IMAGE_SCRIPT="$(BR2_EXTERNAL_ESP_LINUX_BSP_PATH)/board/espressif/esp32s31/post-image.sh"
BR2_ROOTFS_POST_IMAGE_SCRIPT_ARGS="nor"
BR2_LINUX_KERNEL=y
BR2_LINUX_KERNEL_CUSTOM_TARBALL=y
BR2_LINUX_KERNEL_CUSTOM_TARBALL_LOCATION="file:///userdata/esp32s31/archives/linux-dc0e3821e39bd7c169cefd274691e1998a844028-reconstructed.tar.gz"
BR2_LINUX_KERNEL_DEFCONFIG="esp32s31_minimal"
BR2_LINUX_KERNEL_CONFIG_FRAGMENT_FILES="$(BR2_EXTERNAL_ESP_LINUX_BSP_PATH)/board/espressif/esp32s31-mosaico-v1.2/linux.fragment"
BR2_LINUX_KERNEL_IMAGE_TARGET_CUSTOM=y
BR2_LINUX_KERNEL_IMAGE_TARGET_NAME="xipImage"
BR2_LINUX_KERNEL_DTS_SUPPORT=y
BR2_LINUX_KERNEL_INTREE_DTS_NAME="espressif/esp32s31-mosaico-v1.2"
BR2_TARGET_ROOTFS_CPIO=y
BR2_TARGET_ROOTFS_CPIO_GZIP=y
BR2_TARGET_OPENSBI=y
BR2_TARGET_OPENSBI_CUSTOM_TARBALL=y
BR2_TARGET_OPENSBI_CUSTOM_TARBALL_LOCATION="file:///userdata/esp32s31/archives/opensbi-5395e03e1cb295257142cfdeaade6334f1543bcb.tar.gz"
BR2_TARGET_OPENSBI_PLAT="generic"
BR2_TARGET_OPENSBI_ADDITIONAL_VARIABLES="PLATFORM_DEFCONFIG=esp32s31_defconfig PLATFORM_RISCV_XLEN=32"
BR2_TARGET_UBOOT=y
BR2_TARGET_UBOOT_BUILD_SYSTEM_KCONFIG=y
BR2_TARGET_UBOOT_CUSTOM_TARBALL=y
BR2_TARGET_UBOOT_CUSTOM_TARBALL_LOCATION="file:///userdata/esp32s31/archives/u-boot-b2ec9ae21622f92d35462f5ae3bf053466998cc6-reconstructed.tar.gz"
BR2_TARGET_UBOOT_BOARD_DEFCONFIG="espressif_esp32s31"
BR2_TARGET_UBOOT_NEEDS_OPENSBI=y
BR2_TARGET_UBOOT_USE_BINMAN=y
BR2_TARGET_UBOOT_FORMAT_DTB=y
BR2_TARGET_UBOOT_FORMAT_ITB=y
BR2_TARGET_UBOOT_SPL=y
BR2_TARGET_UBOOT_SPL_NAME="spl/u-boot-spl-dtb.bin"
BR2_PACKAGE_HOST_CRAMFS=y
BR2_PACKAGE_HOST_ESP_LINUX_BSP=y
```
